## Documentation/devicetree/bindings/display/panel/edt,etm043080dh6gp.txt
```
Emerging Display Technology Corp. ETM043080DH6-GP 4.3" WQVGA TFT LCD panel

Required properties:
- compatible: should be "edt,etm043080dh6gp"

ETM043080DH6-GP is 480x272 TFT Display with capacitive touchscreen.

This binding is compatible with the simple-panel binding, which is specified
in simple-panel.txt in this directory.
```

## Documentation/devicetree/bindings/gpio/renesas,gpio-rcar.txt
```
* Renesas R-Car GPIO Controller

Required Properties:

  - compatible: should contain one or more of the following:
    - "renesas,gpio-r8a7743": for R8A7743 (RZ/G1M) compatible GPIO controller.
    - "renesas,gpio-r8a7745": for R8A7745 (RZ/G1E) compatible GPIO controller.
    - "renesas,gpio-r8a77470": for R8A77470 (RZ/G1C) compatible GPIO controller.
    - "renesas,gpio-r8a7778": for R8A7778 (R-Mobile M1) compatible GPIO controller.
    - "renesas,gpio-r8a7779": for R8A7779 (R-Car H1) compatible GPIO controller.
    - "renesas,gpio-r8a7790": for R8A7790 (R-Car H2) compatible GPIO controller.
    - "renesas,gpio-r8a7791": for R8A7791 (R-Car M2-W) compatible GPIO controller.
    - "renesas,gpio-r8a7793": for R8A7793 (R-Car M2-N) compatible GPIO controller.
    - "renesas,gpio-r8a7794": for R8A7794 (R-Car E2) compatible GPIO controller.
    - "renesas,gpio-r8a7795": for R8A7795 (R-Car H3) compatible GPIO controller.
    - "renesas,rcar-gen1-gpio": for a generic R-Car Gen1 GPIO controller.
    - "renesas,rcar-gen2-gpio": for a generic R-Car Gen2 or RZ/G1 GPIO controller.
    - "renesas,gpio-rcar": deprecated.

    When compatible with the generic version nodes must list the
    SoC-specific version corresponding to the platform first followed by
    the generic version.

  - reg: Base address and length of each memory resource used by the GPIO
    controller hardware module.

  - interrupt-parent: phandle of the parent interrupt controller.
  - interrupts: Interrupt specifier for the controllers interrupt.

  - gpio-controller: Marks the device node as a gpio controller.
  - #gpio-cells: Should be 2. The first cell is the GPIO number and the second
    cell specifies GPIO flags, as defined in <dt-bindings/gpio/gpio.h>. Only the
    GPIO_ACTIVE_HIGH and GPIO_ACTIVE_LOW flags are supported.
  - gpio-ranges: See gpio.txt.

Optional properties:

  - clocks: Must contain a reference to the functional clock.  The property is
    mandatory if the hardware implements a controllable functional clock for
    the GPIO instance.

  - gpio-reserved-ranges: See gpio.txt.

Please refer to gpio.txt in this directory for the common GPIO bindings used by
client devices.

The GPIO controller also acts as an interrupt controller. It uses the default
two cells specifier as described in Documentation/devicetree/bindings/
interrupt-controller/interrupts.txt.

Example: R8A77470 (RZ/G1C) GPIO controller nodes

	gpio0: gpio@e6050000 {
		compatible = "renesas,gpio-r8a77470",
			     "renesas,rcar-gen2-gpio";
		reg = <0 0xe6050000 0 0x50>;
		interrupts = <GIC_SPI 4 IRQ_TYPE_LEVEL_HIGH>;
		#gpio-cells = <2>;
		gpio-controller;
		gpio-ranges = <&pfc 0 0 23>;
		#interrupt-cells = <2>;
		interrupt-controller;
		clocks = <&mstp9_clks R8A77470_CLK_GPIO0>;
		power-domains = <&cpg_clocks>;
	};
	...
	gpio3: gpio@e6053000 {
		compatible = "renesas,gpio-r8a77470",
			     "renesas,rcar-gen2-gpio";
		reg = <0 0xe6053000 0 0x50>;
		interrupts = <GIC_SPI 7 IRQ_TYPE_LEVEL_HIGH>;
		#gpio-cells = <2>;
		gpio-controller;
		gpio-ranges = <&pfc 0 96 30>;
		gpio-reserved-ranges = <17 10>;
		#interrupt-cells = <2>;
		interrupt-controller;
		clocks = <&mstp9_clks R8A77470_CLK_GPIO3>;
		power-domains = <&cpg_clocks>;
	};
```

## Documentation/devicetree/bindings/reset/renesas,rst.txt
```
DT bindings for the Renesas R-Car and RZ/G Reset Controllers

The R-Car and RZ/G Reset Controllers provide reset control.

Required properties:
  - compatible: Should be
		  - "renesas,<soctype>-rst" for R-Car Gen2 and RZ/G
		Examples with soctypes are:
		  - "renesas,r8a7743-rst" (RZ/G1M)
		  - "renesas,r8a7745-rst" (RZ/G1E)
		  - "renesas,r8a77470-rst" (RZ/G1C)
		  - "renesas,r8a7790-rst" (R-Car H2)
		  - "renesas,r8a7791-rst" (R-Car M2-W)
		  - "renesas,r8a7792-rst" (R-Car V2H
		  - "renesas,r8a7793-rst" (R-Car M2-N)
		  - "renesas,r8a7794-rst" (R-Car E2)
  - reg: Address start and address range for the device.


Example:

	rst: reset-controller@e6160000 {
		compatible = "renesas,r8a7743-rst";
		reg = <0 0xe6160000 0 0x100>;
	};
```

## Documentation/devicetree/bindings/watchdog/renesas-wdt.txt
```
Renesas Watchdog Timer (WDT) Controller

Required properties:
 - compatible : Must be "renesas,<soctype>-wdt", followed by a generic
		fallback compatible string when compatible with the generic
		version.
	       Examples with soctypes are:
		 - "renesas,r8a7742-wdt" (RZ/G1H)
		 - "renesas,r8a7743-wdt" (RZ/G1M)
		 - "renesas,r8a7744-wdt" (RZ/G1N)
		 - "renesas,r8a7745-wdt" (RZ/G1E)
		 - "renesas,r8a77470-wdt" (RZ/G1C)
		The generic compatible string must be:
		 - "renesas,rcar-gen2-wdt" for R-Car Gen2 and RZ/G

  When compatible with the generic version, nodes must list the SoC-specific
  version corresponding to the platform first, followed by the generic
  version.

- reg : Should contain WDT registers location and length
- clocks : the clock feeding the watchdog timer.

Optional properties:
- timeout-sec : Contains the watchdog timeout in seconds
- power-domains : the power domain the WDT belongs to

Examples:

	rwdt: watchdog@e6020000 {
		compatible = "renesas,r8a7743-wdt",
			     "renesas,rcar-gen2-wdt";
		reg = <0 0xe6020000 0 0x0c>;
		clocks = <&mstp4_clks R8A7743_CLK_RWDT>;
		power-domains = <&cpg_clocks>;
		timeout-sec = <60>;
	};
```
